## boards/shields/sofle_dongle/Kconfig.shield
```kconfig
# No whitespace after the comma or in the keyboard name!
config SOFLE_LEFT
    def_bool $(shields_list_contains,sofle_left)

config SOFLE_RIGHT
    def_bool $(shields_list_contains,sofle_right)
```
