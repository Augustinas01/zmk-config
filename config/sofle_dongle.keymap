#define BASE 0
#define LOWER 1
#define RAISE 2
#define ADJUST 3

/ {
    conditional_layers {
        compatible = "zmk,conditional-layers";

        adjust_layer {
            if-layers = <LOWER RAISE>;
            then-layer = <ADJUST>;
        };
    };
};